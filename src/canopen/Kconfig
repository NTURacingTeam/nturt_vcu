## src/canopen/Kconfig
```kconfig
menuconfig VCU_CANOPEN
	bool "CANopen support"
	select NTURT_CANOPEN

if VCU_CANOPEN

config VCU_CANOPEN_MSG
	bool "Publish messages from CANOPEN writes (RPDO or SDO)"
	depends on VCU_MSG
	default y

config VCU_CANOPEN_TM
	bool "Publish TPDO from the update of telemetry data"
	depends on VCU_TM
	default y

endif # VCU_CANOPEN
```

## src/ctrl/Kconfig
```kconfig
rsource "states/Kconfig"

menuconfig VCU_CTRL
	bool "Control system"
	select VCU_SYS
	select VCU_MSG
	select VCU_STATES

if VCU_CTRL

config VCU_CTRL_INIT_PRIORITY
	int "Control system initialization priority"
	default 40

config VCU_CTRL_STACK_SIZE
	int "Control system thread stack size"
	default 4096

config VCU_CTRL_THREAD_PRIORITY
	int "Control system thread priority"
	default 0

config VCU_CTRL_SETTINGS
	bool "Control system settings support"
	depends on SETTINGS
	default y

endif # VCU_CTRL
```

## src/ctrl/states/Kconfig
```kconfig
menuconfig VCU_STATES
	bool "Control system state machine"
	select SMF
	select SMF_ANCESTOR_SUPPORT
	select SMF_INITIAL_TRANSITION

if VCU_STATES

config VCU_STATES_INIT_PRIORITY
	int "Init priority"
	default 30
	help
	  Control system state machine initialization priority.

config VCU_STATES_CHECK_PEDAL
	bool "Check pedal states for RTD readiness"
	default y
	help
	  When enabled, only when accelerator is not engaged and brake is engaged
	  can start RTD.

choice VCU_STATES_TRANS_MODE
	prompt "Control system state transition process mode"
	default VCU_STATES_TRANS_SYS_WORKQUEUE if VCU_SYS
	default VCU_STATES_TRANS_SYNC

config VCU_STATES_TRANS_SYNC
	bool "Process control system state transition synchronously"
	help
	  State transitions and their cooresponding trnasition callbacks are
	  processed synchronously in the context of the code that requests state
	  transitions.

config VCU_STATES_TRANS_SYS_WORKQUEUE
	bool "Process control system state transition in system workqueue"
	help
	  State transitions are deferred to system workqueue where state
	  transitions and their corresponding transition callbacks are processed
	  asynchronously.
	depends on VCU_SYS

endchoice # VCU_STATES_TRANS_MODE

if !VCU_STATES_TRANS_SYNC

config VCU_STATES_TRANS_DEFER_PRIORITY
	int "Init priority to start processing state transitions asynchronously"
	default 95
	help
	  Start processing state transitions asynchronously to ensure a consistent
	  view of the state machine during initialization and to prevent blocking
	  due to the sys workqueue not starting yet.

endif # !VCU_STATES_TRANS_SYNC

config VCU_STATES_ERR
	bool "State machine error handling support"
	depends on NTURT_ERR
	default y

if VCU_STATES_ERR

choice VCU_STATES_TRANS_TO_ERROR_ON_SEVERITY
	prompt "Error severity to transition to error state"
	default VCU_STATES_TRANS_TO_ERROR_ON_FATAL

config VCU_STATES_TRANS_TO_ERROR_ON_FATAL
	bool "Transition to error state on fatal errors"

config VCU_STATES_TRANS_TO_ERROR_ON_WARNING
	bool "Transition to error state on warning errors"

endchoice

endif # VCU_STATES_ERR

config VCU_STATES_MSG
	bool "Control system state machine message support"
	depends on VCU_MSG
	default y

config VCU_STATES_SHELL
	bool "Control system state machine shell support"
	depends on VCU_SHELL
	default y

endif # VCU_STATES
```

## src/dashboard/Kconfig
```kconfig
menuconfig VCU_DASHBOARD
	bool "Dashboard system"
	select LED
	select LED_STRIP
	select AUXDISPLAY
	select VCU_SYS
	select VCU_STATES
	select VCU_CTRL

if VCU_DASHBOARD

config VCU_DASHBOARD_INIT_PRIORITY
	int "Init priority"
	default 50
	help
	  Dashboard system initialization priority.

config VCU_DASHBOARD_SHELL
	bool "Dashboard shell support"
	depends on VCU_SHELL
	default y
	select LED_SHELL

config VCU_DASHBOARD_SETTINGS
	bool "Dashboard settings support"
	depends on SETTINGS
	default y

endif # VCU_DASHBOARD
```

## src/dashboard/display/Kconfig
```kconfig
menuconfig VCU_DISPLAY
	bool "VCU dashboard display"
	depends on VCU_DASHBOARD
	select DISPLAY
	select LVGL

if VCU_DISPLAY

config LV_COLOR_16_SWAP
	default y if LV_COLOR_DEPTH_16

config VCU_DISPLAY_SHELL
	bool
	depends on VCU_DASHBOARD_SHELL
	default y
	select LV_Z_SHELL

endif # VCU_DISPLAY
```

## src/msg/Kconfig
```kconfig
menuconfig VCU_MSG
	bool "VCU inter-thread communication system"
	select NTURT_MSG

if VCU_MSG

config VCU_MSG_LOGGING
	bool "Start logging messages when running"
	depends on NTURT_FS
	depends on NTURT_MSG_LOGGING
	depends on VCU_STATES
	default y

if VCU_MSG_LOGGING

config VCU_MSG_LOGGING_DIR
	string "VCU message logging directory"
	default "/SD:/msg_logs"
	help
	  Directory where VCU message logs will be stored.

endif # VCU_MSG_LOGGING

endif # VCU_MSG
```

## src/perception/Kconfig
```kconfig
menuconfig VCU_PERCEPTION
	bool "Perception system"
	# select SENSING
	select NTURT_MSG
	select VCU_SENSORS
	# select VCU_KALMAN

if VCU_PERCEPTION

rsource "kalman/Kconfig"
rsource "sensors/Kconfig"

endif # VCU_PERCEPTION
```

## src/perception/sensors/Kconfig
```kconfig
menuconfig VCU_SENSORS
	bool "Sensor and input system"
	default y
	select SENSOR
	select INPUT
	select INPUT_THREAD_PRIORITY_OVERRIDE
	select VCU_SYS

if VCU_SENSORS

config INPUT_THREAD_PRIORITY
	default 1

config INPUT_SENSOR_AXIS_THREAD_PRIORITY
	default 1

config VCU_SENSORS_INIT_PRIORITY
	int "Init priority"
	default 50
	help
	  Sensor and input system initialization priority.

config VCU_SENSORS_PEDAL_PLAUS
	bool "Pedal plausibility check"
	default y
	help
	  Enable plausibility check for pedals according to the FSAE rule EV4.7,
	  APPS / Brake Pedal Plausibility Check.

config VCU_SENSORS_SHELL
	bool "Sensor and input shell"
	depends on VCU_SHELL
	default y
	select SENSOR_SHELL
	select INPUT_SHELL
	select INPUT_EVENT_DUMP

endif # VCU_SENSORS
```

## src/sys/Kconfig
```kconfig
menuconfig VCU_SYS
	bool "Basic system support"
	select LOG
	select SETTINGS
	select NTURT_SYS
	select NTURT_FS

if VCU_SYS

config VCU_SHELL
	bool "Shell support"
	select SETTINGS_SHELL
	select NTURT_SHELL

config RTC_SHELL
	default y
config GPIO_SHELL
	default y
config PWM_SHELL
	default y
config ADC_SHELL
	default y
config UART_SHELL
	default y
config I2C_SHELL
	default y
config SPI_SHELL
	default y

endif # VCU_SYS
```

## src/telemetry/Kconfig
```kconfig
menuconfig VCU_TM
	bool "Telemetry support"
	select NTURT_TM

if VCU_TM

config VCU_TM_MSG
	bool "Update telemetry data from message"
	depends on VCU_MSG
	default y

endif # VCU_TM
```
